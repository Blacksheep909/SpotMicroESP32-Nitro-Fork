//add required libraries
#include <Wire.h>
#include <Adafruit_MPU6050.h>
#include <Adafruit_Sensor.h>
#include <Adafruit_PWMServoDriver.h>
#include <IBusBM.h>
#include <Arduino.h>
#include <Ramp.h>
#include "esp_task_wdt.h"
#include <math.h>
#include <SPI.h>
#include <Adafruit_GFX.h>
#include <Adafruit_SSD1306.h>

//--------------------------------------------------------------------------------------------------
Adafruit_PWMServoDriver pwm = Adafruit_PWMServoDriver();
// Called this way, it uses the default address 0x40

// Define min and max servo distances
#define SERVOMIN 125  // this is the 'minimum' pulse length count (out of 4096)
#define SERVOMAX 575  // this is the 'maximum' pulse length count (out of 4096)

//--------------------------------------------------------------------------------------------------
// Include iBusBM Library
#include <IBusBM.h>
IBusBM ibus;
HardwareSerial IBusSerial(1);  // Use UART1, which is available on the ESP32

esp_timer_handle_t failsafeTimer;
bool failsafeTriggered = false;
int FailSafeValue = 1500;
int radiansToDegrees(float radians) {
  return radians * (180.0 / PI);
}
//--------------------------------------------------------------------------------------------------
//Define Ultrasonic Sensors
//Define ULTRASONIC SENSOR 1 pinout
#define TRIG_PIN 33  // ESP32 pin GPIO connected to Ultrasonic Sensor's TRIG pin
#define ECHO_PIN 34  // ESP32 pin GPIO connected to Ultrasonic Sensor's ECHO pin
//Defines variables for Ultrasonic 1
long duration;
int distance;
int distanceMax = 400;
int distanceFuse;

//Define ULTRASONIC SENSOR 2 pinout
#define TRIG_PIN2 32  // ESP32 pin GPIO connected to Ultrasonic Sensor's TRIG pin
#define ECHO_PIN2 35  // ESP32 pin GPIO connected to Ultrasonic Sensor's ECHO pin
//Defines variables for Ultrasonic 2
long duration2;
int distance2;
int distanceMax2 = 400;
int distanceFuse2;
//--------------------------------------------------------------------------------------------------

//Define relay pin
const int pinNumber27 = 27;
//Define button LED pin
const int pinNumber2 = 2;
//Define frontal LED pin
const int pinNumber13 = 13;
//Define Voltage Sensor offset
int voltage_offset = 20;
//Define Buzzer pin 
const int buzzerPin = 16;  //Buzzer to pin 16
//Define Gyro
Adafruit_MPU6050 mpu;
//Define Battery Cell Count
int CellCount = 4;  //Put the amount of cells in your lipo battery here

//Define variables for millis
unsigned long currentMillis;
unsigned long firstLoopPeriod = 0;             // For the first loop
unsigned long secondLoopPeriod = 0;            // For the second loop
const unsigned long firstLoopInterval = 5000;   // Interval for the first loop (5 seconds)
const unsigned long secondLoopInterval = 10;  // Interval for the second loop (0.001 second)                   
long interval = 10;                            // time constant for timer
unsigned long count;

long previousInterpMillis = 0;  // set up timers
int interpFlag = 0;

int stepStartFlag = 0;
int timer1;
float timerScale;

//Assign channels for walk
float RFB = 0;
float RLR = 0;
float LT = 0;

float RLRFiltered = 0;
float RFBFiltered = 0;
float LTFiltered = 0;


//Walk variables
int stepFlagFB = 0;
int stepFlagLR = 0;

unsigned long stepTimer;
long previousStepMillis = 10;

int isWalking = 0;
//--------------------------------------------------------------------------------------------------
//LED BUTTON SETUP
void LightStartup() {
  pinMode(pinNumber2, OUTPUT);
  pinMode(pinNumber13, OUTPUT);
  for (int i = 0; i < 6; i++) {
    digitalWrite(pinNumber2, HIGH);
    digitalWrite(pinNumber13, HIGH);
    delay(100 + i * 50);  // Increase delay incrementally
    digitalWrite(pinNumber2, LOW);
    digitalWrite(pinNumber13, LOW);
    delay(100);
  }
  digitalWrite(pinNumber2, HIGH);
  digitalWrite(pinNumber13, HIGH);
}
//--------------------------------------------------------------------------------------------------
//OLED SETUP
#define SCREEN_WIDTH 128  // OLED display width, in pixels
#define SCREEN_HEIGHT 64  // OLED display height, in pixels

// Declaration for an SSD1306 display connected to I2C (SDA, SCL pins)
#define OLED_RESET     -1 // Reset pin (or -1 if sharing Arduino reset pin)
Adafruit_SSD1306 display(SCREEN_WIDTH, SCREEN_HEIGHT, &Wire, OLED_RESET);

//Dog aniatiom Frame Definitions
#define FRAME_DELAY (42)
#define FRAME_WIDTH (64)
#define FRAME_HEIGHT (64)
#define FRAME_COUNT (sizeof(frames) / sizeof(frames[0]))
//Define frame for animation startup as 0
int frame = 0;
//STARTUP ANIMATION
const byte PROGMEM frames[][512] = {
  {0,0,0,0,0,0,0,0,0,0,0,0,0,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0,0},
  {0,0,0,0,0,0,0,0,0,0,0,0,0,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0,0},
  {0,0,0,0,0,0,0,0,0,0,0,0,0,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0,0},
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  {0,0,0,0,0,0,0,0,0,0,0,0,0,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0,0}
};
void powerOnAnimation() {
  //Startup Dog Animation
  for (int i = 0; i < FRAME_COUNT; i++) {
    display.clearDisplay();
    display.drawBitmap(32, 0, frames[i], FRAME_WIDTH, FRAME_HEIGHT, 1);
    display.display();
    delay(FRAME_DELAY);
  }
  display.clearDisplay();

  // Draw a quick loading 
  for (int i = 0; i <= SCREEN_WIDTH; i += 8) {
    display.fillRect(0, 40, i, 10, WHITE);
    display.display();
    delay(25);  // Quick loading effect
  }
  
  // Show "READY!" message
  display.clearDisplay();
  display.setTextSize(2);  // 12x16 pixel size for each character
  display.setTextColor(WHITE);

  // "READY!" is 6 characters long
  int16_t textWidth = 12 * 6;  // 6 pixels per character * 9 characters
  int16_t xPosition = (SCREEN_WIDTH - textWidth) / 2;  // Center horizontally

  display.setCursor(xPosition, (SCREEN_HEIGHT - 16) / 2);  // Vertically center
  display.println("READY!");
  display.display();
  delay(100);
}
//--------------------------------------------------------------------------------------------------
//Function to convert pulse to angle for servos
int angleToPulse(int ang) {
  int pulse = map(ang, 0, 180, SERVOMIN, SERVOMAX);  // map angle of 0 to 180 to Servo min and Servo max
  return pulse;
}

float filter(float prevValue, float currentValue, int filter) {
    float lengthFiltered = (prevValue + (currentValue * filter)) / (filter + 1);
    return lengthFiltered;
}

//--------------------------------------------------------------------------------------------------
// Define debounce delay
const unsigned long debounceDelay = 1;  // Adjust debounce timer to needed amount for packet delay header (1ms)

// State tracking variables
int lastChannel5State;
int lastStableChannel5State;
unsigned long lastChannel5ChangeTime;

int lastChannel6State;
int lastStableChannel6State;
unsigned long lastChannel6ChangeTime;

// Initialize current state and action state
enum State 
{ 
  LIE_DOWN = 'L', 
  STAND_UP = 'S'
};
enum ActionState 
{ 
  TILT_STATE = 'T', 
  HANDSHAKE_STATE = 'H', 
  WALK_STATE = 'W'
};

State currentState = LIE_DOWN;
ActionState currentActionState = TILT_STATE;

//--------------------------------------------------------------------------------------------------
void setup() {
  //Start the serial monitor
  Serial.begin(115200);
  //Start the millis timer
  millis();
  xPortGetCoreID();  //which core is the program running on.
  //--------------------------------------------------------------------------------------------------
  // Initialize the hardware serial for IBus
  IBusSerial.begin(115200, SERIAL_8N1, 3, -1);  // Use GPIO3 (RX) and -1 (TX not used)

  // Initialize IBusBM with the hardware serial object
  ibus.begin(IBusSerial);
  //--------------------------------------------------------------------------------------------------
  //RELAY
  pinMode(pinNumber27, OUTPUT);
  digitalWrite(pinNumber27, HIGH);  //set relay pin as ON, by turning it to HIGH

  //--------------------------------------------------------------------------------------------------
  //LED BUTTON SETUP
  LightStartup();

  //--------------------------------------------------------------------------------------------------
  //OLED SETUP
  // Initialize OLED display with I2C address 0x3C
  if (!display.begin(SSD1306_SWITCHCAPVCC, 0x3C)) {
    Serial.println(F("SSD1306 OLED allocation failed"));
    for (;;);
  }
  display.clearDisplay();
  display.display();

  // Power-on animation: Dog icon, quick loading bar, and end animation
  powerOnAnimation();

  //--------------------------------------------------------------------------------------------------
  //Buzzer Startup Melody Play
  pinMode(buzzerPin, OUTPUT);  // Set buzzer - pin 16 as an output
  for (int i = 1000; i < 2000; i += 250) {
    tone(buzzerPin, i, 150);
    delay(150);
  }
  noTone(buzzerPin);
  //--------------------------------------------------------------------------------------------------
  //ULTRASONIC SENSOR SETUP
  //SENSOR 1
  pinMode(TRIG_PIN, OUTPUT);  // Sets the TRIG_PIN as an Output
  pinMode(ECHO_PIN, INPUT);   // Sets the ECHO_PIN as an Input
  //SENSOR 2
  pinMode(TRIG_PIN2, OUTPUT);  // Sets the TRIG_PIN as an Output
  pinMode(ECHO_PIN2, INPUT);   // Sets the ECHO_PIN as an Input

  //--------------------------------------------------------------------------------------------------
  //PCA9685 BOARD SETUP
  pwm.begin();
  pwm.setPWMFreq(60);  // Analog servos run at ~60 Hz updates

  //--------------------------------------------------------------------------------------------------
  // MPU6050 Setup
  while (!Serial) delay(10);  // Wait for Serial Monitor to open
  Serial.println("Initializing MPU6050...");

  if (!mpu.begin()) {  // Check if MPU6050 is found
    Serial.println("Failed to find MPU6050 chip");
    while (1) delay(10);  // Infinite loop
  }
  Serial.println("MPU6050 Found!");

  // Configure MPU6050 parameters for lowest sensitivity
  mpu.setAccelerometerRange(MPU6050_RANGE_16_G);
  mpu.setGyroRange(MPU6050_RANGE_2000_DEG);
  mpu.setFilterBandwidth(MPU6050_BAND_5_HZ);

  //--------------------------------------------------------------------------------------------------
  //Dog Startup Sequences
  LD_Func();
  //--------------------------------------------------------------------------------------------------
}
//--------------------------------------------------------------------------------------------------
void loop() {
  //First millis-based loop (Data Collection and Print)
  currentMillis = millis();                                    //millis since program started
  if (currentMillis - firstLoopPeriod >= firstLoopInterval) {  // check if time elapsed
    //-----------------------------------------------------------------------
    //Get all data
    //-----------------------------------------------
    // Get sensor readings from the MPU6050 6050 (gyro)
    sensors_event_t a, g, temp;
    mpu.getEvent(&a, &g, &temp);

    //-----------------------------------------------
    //Get sensor readings from our voltmeter
    int volt = analogRead(36);  // read the input - GPIO_NUM_36
    double voltage = map(volt, 0, 4096, 0, 1650) + voltage_offset;
    voltage /= 100;  // divide by 100 to get the decimal values

    //-----------------------------------------------
    //Get sensor readings from our ammeter
    unsigned int x = 0;
    float AcsValue = 0.0, Samples = 0.0, AvgAcs = 0.0, AcsValueF = 0.0;
    for (int x = 0; x < 150; x++) {  //Get 150 samples
      AcsValue = analogRead(39);     //Read current sensor values
      Samples = Samples + AcsValue;  //Add samples together
      delay(3);                      // let ADC settle before next sample 3ms
    }
    AvgAcs = Samples / 150.0;  //Taking Average of Samples
    //((AvgAcs * (5.0 / 1024.0)) is converting the read voltage in 0-5 volts
    //'voltage' variable is offset(I assumed that arduino is working on 5v so the viout at no current comes
    //out to be 2.5 which is out offset. If your arduino is working on different voltage than
    //you must change the offset according to the input voltage)
    //0.066v(66mV) is rise in output voltage when 1A current flows at input
    AcsValueF = (2.5 - (AvgAcs * (1.25 / 1024.0))) / 0.066;
    //-----------------------------------------------


    //Read ultrasonic sensor data
    //SENSOR 1
    // Clears the TRIG_PIN
    digitalWrite(TRIG_PIN, LOW);
    delay(2);
    // Sets the TRIG_PIN on HIGH state for 10 micro seconds
    digitalWrite(TRIG_PIN, HIGH);
    delay(10);
    digitalWrite(TRIG_PIN, LOW);
    // Reads the ECHO_PIN, returns the sound wave travel time in microseconds
    duration = pulseIn(ECHO_PIN, HIGH);
    // Calculating the distance
    distance = duration * 0.034 / 2;
    //SENSOR 2
    // Clears the TRIG_PIN
    digitalWrite(TRIG_PIN2, LOW);
    delay(2);
    // Sets the TRIG_PIN on HIGH state for 10 micro seconds
    digitalWrite(TRIG_PIN2, HIGH);
    delay(10);
    digitalWrite(TRIG_PIN2, LOW);
    // Reads the ECHO_PIN, returns the sound wave travel time in microseconds
    duration2 = pulseIn(ECHO_PIN2, HIGH);
    // Calculating the distance
    distance2 = duration2 * 0.034 / 2;

    //-------------------------------------------------------------------------------------

    //Print 3 blank lines before the data
    Serial.println("");
    Serial.println("");
    Serial.println("");

    //Print MPU6050 data
    Serial.print("Acceleration X: ");
    Serial.print(a.acceleration.x + 0);
    Serial.print(", Y: ");
    Serial.print(a.acceleration.y + 0);
    Serial.print(", Z: ");
    Serial.print(a.acceleration.z + 0.77);
    Serial.println(" m/s^2");

    Serial.print("Rotation X: ");
    Serial.print(g.gyro.x * 57.2958);  // Convert radians to degrees
    Serial.print(" deg/s, Y: ");
    Serial.print(g.gyro.y * 57.2958);  // Convert radians to degrees
    Serial.print(" deg/s, Z: ");
    Serial.print(g.gyro.z * 57.2958);  // Convert radians to degrees
    Serial.println(" deg/s");

    Serial.print("Temperature: ");
    Serial.print(temp.temperature);
    Serial.println(" degC");

    //Print the voltage sensor data
    Serial.print("Voltage: ");
    Serial.print(voltage);
    Serial.println("V");
    Serial.print("Cell Voltage: ");
    Serial.print(voltage / CellCount);
    Serial.println("V");
    //-----------------------------------------------------------------------
    //Print the current sensor data
    Serial.print("Current: ");
    int Current_Current = 0;
    Current_Current = AcsValueF;
    Serial.print(Current_Current);  //Print the read current on Serial monitor
    Serial.println("A");

    if (Current_Current < -25) {//if current read value is to high,
      digitalWrite(pinNumber27, LOW);//turn relay off to protect dog.
      Serial.print("OVERCURRENT!");//print overcurrent,
      // Show "OVERCURRENT!" message
      display.clearDisplay();
      display.setTextSize(2);  // 12x16 pixel size for each character
      display.setTextColor(WHITE);


      // "OVERCURRENT!" is 11 characters long
      int16_t textWidth = 12 * 11;  // 12 pixels per character * 11 characters
      int16_t xPosition = (SCREEN_WIDTH - textWidth) / 2;  // Center horizontally

      display.setCursor(xPosition, (SCREEN_HEIGHT - 16) / 2);  // Vertically center
      display.println("OVERCURRENT!");
      display.display();

      for (int i = 1000; i >= 200; i -= 200) {
        tone(buzzerPin, i, 200);
        delay(250);
      }
    }
    //Print data for ultrasonic sensor 1
    Serial.print("Distance2:");
    if ((distance) > (distanceMax)) {
      Serial.print("Invalid Distance");
      Serial.println(" ");
    } else {
      Serial.print(distance);
      distance = distanceFuse;
      Serial.println(" cm");
    }

    //Prints the data for ultrasonic sensor 2
    Serial.print("Distance1:");
    if ((distance2) > (distanceMax2)) {
      Serial.print("Invalid Distance");
      Serial.println(" ");
    } else {
      Serial.print(distance2);
      distance2 = distanceFuse2;
      Serial.println(" cm");
    }
    //Sound buzzer if battery is below 3.5V
    if (voltage <= 3.75 && voltage >= 3) {
      digitalWrite(pinNumber27, LOW);//turn relay off to protect dog.
      for (int i = 1000; i >= 200; i -= 200) {
        tone(buzzerPin, i, 200);
        delay(250);
      }
      noTone(buzzerPin);
      SD_Func_Invert();
      Serial.println("BATTERY LOW!");
      // Show "BATTERY LOW!" message
      display.clearDisplay();
      display.setTextSize(2);  // 12x16 pixel size for each character
      display.setTextColor(WHITE);


      // "BATTERY LOW!" is 12 characters long
      int16_t textWidth = 12 * 12;  // 12 pixels per character * 12 characters
      int16_t xPosition = (SCREEN_WIDTH - textWidth) / 2;  // Center horizontally

      display.setCursor(xPosition, (SCREEN_HEIGHT - 16) / 2);  // Vertically center
      display.println("BATTERY LOW!");
      display.display();
    }
    //Print Current Action State
    Serial.print("Action Position: ");
    Serial.println((char) currentActionState);
    //Print Current State
    Serial.print("Current State: ");
    Serial.println((char) currentState);

    //-----------------------------------------------------------------------

    display.clearDisplay();
    display.setTextSize(1);      // Small text
    display.setCursor(0, 0);

    // Print the data panel to the display
    display.println("    ");
    display.println("Status: #PainInTheAss");
    display.println("    ");
    display.print("Voltage: ");
    display.print(voltage);
    display.println("V");

    display.print("Cell Voltage: ");
    display.print(voltage / CellCount);
    display.println("V");

    display.println("    ");
    display.print("Current State: ");
    display.println((char) currentState);

    display.print("Action Position: ");
    display.println((char) currentActionState);

    // Show everything on the display
    display.display();
  }
  //-----------------------------------------------
  // Second millis-based loop (IBUS data collection and movement updates)
  if (currentMillis - secondLoopPeriod >= secondLoopInterval) {  // check if time elapsed
    secondLoopPeriod += secondLoopInterval;
    //-----------------------------------------------------------------------
    // Check the state of channel 6 (aux switch)
    int channel6 = ibus.readChannel(5);  // Channels are zero-indexed
    // Debounce logic for channel 6
    if (channel6 != lastChannel6State) {
      lastChannel6ChangeTime = millis();
      lastChannel6State = channel6;
    }
    if ((millis() - lastChannel6ChangeTime) > debounceDelay) {
      if (lastStableChannel6State != channel6) {
        lastStableChannel6State = channel6;
        // Define the threshold value for the aux switch
        int threshold_Channel6 = 1500;  // Adjust based on your switch's range (e.g., 1000-2000)
        // If the aux switch is activated and the dog is in lie down state, stand up
        if (channel6 > threshold_Channel6 && currentState == LIE_DOWN) {
          currentState = STAND_UP;
          tone(buzzerPin, 2000);
          delay(100);
          noTone(buzzerPin);  //Stop sound
          SD_Func();
        }
        // If the aux switch is deactivated and the dog is in stand up state, lie down
        if (channel6 <= threshold_Channel6 && currentState == STAND_UP) {
          currentState = LIE_DOWN;
          currentActionState = TILT_STATE;
          tone(buzzerPin, 2000);
          delay(100);
          noTone(buzzerPin);  //Stop sound
          SD_Func_Invert();
        }
      }
    }

    //-----------------------------------------------------------------------
    // Check the state of channel 5 (aux switch)
    int channel5 = ibus.readChannel(4);  // Channels are zero-indexed
    // Debounce logic for channel 5
    if (channel5 != lastChannel5State) {
      lastChannel5ChangeTime = millis();
      lastChannel5State = channel5;
    }
    if ((millis() - lastChannel5ChangeTime) > debounceDelay) {
      if (lastStableChannel5State != channel5) {
        lastStableChannel5State = channel5;
        // Define the threshold value for the aux switch
        // Define the threshold values for the 3-position switch
        int threshold_Channel5_Mid_Low = 1334;   // Lower bound of mid-position
        int threshold_Channel5_Mid_High = 1666;  // Upper bound of mid-position
        int threshold_Channel5_High = 1667;      // Lower bound of high-position
        if (channel5 <= threshold_Channel5_Mid_High && channel5 > threshold_Channel5_Mid_Low && currentActionState != HANDSHAKE_STATE && currentState == STAND_UP) {
          currentActionState = HANDSHAKE_STATE; //MIDDLE
          Serial.print("Current Action State: ");
          Serial.print(currentActionState);
          tone(buzzerPin, 3000);
          delay(100);
          noTone(buzzerPin);
          SDS_Func();
        }
        if (channel5 <= threshold_Channel5_Mid_Low && currentActionState != TILT_STATE && currentState == STAND_UP ) {
          currentActionState = TILT_STATE; //TOP  
          Serial.print("Current Action State: ");
          Serial.print(currentActionState);
          tone(buzzerPin, 3000);
          delay(100);
          noTone(buzzerPin);
        }
        if (channel5 > threshold_Channel5_High && currentActionState != WALK_STATE && currentState == STAND_UP) {
          currentActionState = WALK_STATE; //LOWEST
          Serial.print("Current Action State: ");
          Serial.print(currentActionState);
          tone(buzzerPin, 3000);
          delay(100);
          noTone(buzzerPin);
        }
      }
    }
    //-----------------------------------------------------------------------
    //Place if current action state code here
    if (currentActionState == TILT_STATE && currentState == STAND_UP) {
      //TILT STATE CODE HERE
      isWalking = 0;
    }
    if (currentActionState == HANDSHAKE_STATE && currentState == STAND_UP) {
      // Read the angle value from channel 1 (pitch stick)
      int joystickValueFB = ibus.readChannel(1);

      // Map the joystick value to the angle range for the paw servo
      int HandShakeAngle = map(joystickValueFB, -100, 100, 70, 110);

      // Set the angle for the front right paw servo
      pwm.setPWM(5, 0, HandShakeAngle);
      isWalking = 0;
    }
    if (currentActionState == WALK_STATE && currentState == STAND_UP) {
      isWalking = 1;
      WalkFunc();
    }

  }
  //Reset ESP32 Watchdog Timer
  esp_task_wdt_reset();
  //FAILSAFE CONTEND
  if (ibus.readChannel(2) >= 1965 && ibus.readChannel(3) >= 1750) {
    failsafeTriggered = true; // Set failsafe flag
    RFB = 1500; //Set all joystick values to middle so that dog doesn't move while in failsafe
    RLR = 1500;
    LT = 1500;
    tone(buzzerPin, 1000, 300); delay(350); tone(buzzerPin, 500, 300); // Melody for disconnect
    noTone(buzzerPin);
    Serial.println("Transmitter Disconnected!"); //Print Serial
    Serial.println("Executing failsafe action..."); //Print Serial
    // Show "FAILSAFE!" message
    display.clearDisplay();
    display.setTextSize(2);  // 12x16 pixel size for each character
    display.setTextColor(WHITE);
    // "FAILSAFE!" is 9 characters long
    int16_t textWidth = 9 * 12;  // 12 pixels per character * 9 characters
    int16_t xPosition = (SCREEN_WIDTH - textWidth) / 2;  // Center horizontally

    display.setCursor(xPosition, (SCREEN_HEIGHT - 16) / 2);  // Vertically center
    display.println("FAILSAFE!");
    display.display();

    if (currentState == STAND_UP) {
      SD_Func_Invert(); //Sit down
      currentState = LIE_DOWN;
    }
    currentState = LIE_DOWN;
    while (failsafeTriggered = true) {
      int FailSafeValue = ibus.readChannel(2);
      int FailSafeValue2 = ibus.readChannel(3);
      delay(10);
      isWalking = 0;
      if (FailSafeValue2 <= 1750) { //If FailSafeValue is less than failsafe amount (which gets set on failsafe), than we are no longer disconnected
        failsafeTriggered = false;
        Serial.println("Transmitter Reconnected!");
        // Show "RECONNECTED!" message with a cheeky comment
        display.clearDisplay();
        display.setTextSize(2);  // 12x16 pixel size for each character


        // "RECONNECTED!" is 12 characters long
        int16_t textWidth = 12 * 9;  // 12 pixels per character * 9 characters
        int16_t xPosition = (SCREEN_WIDTH - textWidth) / 2;  // Center horizontally

        display.setCursor(xPosition, (SCREEN_HEIGHT - 16) / 2);  // Vertically center
        display.println("CONNECTED");
        display.display();

        // Display cheeky comment below
        delay(1500);  // Wait 1.5 seconds to let user enjoy the moment
        display.clearDisplay();
        tone(buzzerPin, 3000);
        delay(100);
        noTone(buzzerPin);
        tone(buzzerPin, 3000);
        delay(100);
        noTone(buzzerPin);
        break;
      }
    }
  }
  else {
    failsafeTriggered = false; // Reset failsafe flag
  }
  //
}